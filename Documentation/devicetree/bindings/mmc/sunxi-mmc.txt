## Documentation/devicetree/bindings/mmc/sunxi-mmc.txt
```
* Allwinner sunxi MMC controller

The highspeed MMC host controller on Allwinner SoCs provides an interface
for MMC, SD and SDIO types of memory cards.

Supported maximum speeds are the ones of the eMMC standard 4.5 as well
as the speed of SD standard 3.0.
Absolute maximum transfer rate is 200MB/s

Required properties:
- compatible: Should be "allwinner,<revision>-<chip>-mmc".
  The supported chips include a10, a10s, 13, a20 and a31.
- base registers are 0x1000 appart, so the base of mmc1
  would be 0x01c0f000+0x1000=0x01c10000(see example)
  and so on.
- clocks requires the reference at the ahb clock gate
  with the correct index (mmc0 -> 8, mmc1 -> 9, and so on)
  as well as the reference to the correct mod0 clock.
- interrupts requires the correct IRQ line
  (mmc0 -> 32, mmc1 -> 33, and so on)

Examples:

mmc0: mmc@01c0f000 {
	compatible = "allwinner,sun5i-a13-mmc";
	reg = <0x01c0f000 0x1000>;
	clocks = <&ahb_gates 8>, <&mmc0_clk>;
	clock-names = "ahb", "mod";
	interrupts = <0 32 4>;
	bus-width = <4>;
	status = "disabled";
};
```

## Documentation/devicetree/bindings/phy/sun4i-usb-phy.txt
```
Allwinner sun4i USB PHY
-----------------------

Required properties:
- compatible : should be one of "allwinner,sun4i-a10-usb-phy",
  "allwinner,sun5i-a13-usb-phy" or "allwinner,sun7i-a20-usb-phy"
- reg : a list of offset + length pairs, the 1st list entry should point to
  the phy base regs, the 2nd entry to the pmu reg for phy1, and the 3th
  entry to the pmu reg of phy2 (for devices which have a phy2).
- #phy-cells : from the generic phy bindings, must be 1

Optional properties:
- clocks : phandle + clock specifier for the phy clock
- clock-names : "usb_phy"
- resets : a list of phandle + reset specifier pairs
- reset-names : "usb0_reset", "usb1_reset", and / or "usb2_reset"

Example:
	usbphy: phy@0x01c13400 {
		#phy-cells = <1>;
		compatible = "allwinner,sun4i-a10-usb-phy";
		/* phy base regs, phy1 pmu reg, phy2 pmu reg */
		reg = <0x01c13400 0x10 0x01c14800 0x4 0x01c1c800 0x4>;
		clocks = <&usb_clk 8>;
		clock-names = "usb_phy";
		resets = <&usb_clk 1>, <&usb_clk 2>;
		reset-names = "usb1_reset", "usb2_reset";
	};
```
